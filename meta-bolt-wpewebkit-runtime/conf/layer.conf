## meta-bolt-wpewebkit-runtime/conf/layer.conf
```bitbake
BBPATH .= ":${LAYERDIR}"

BBFILES += "${LAYERDIR}/recipes-*/*/*.bb \
            ${LAYERDIR}/recipes-*/*/*.bbappend"

BBFILE_COLLECTIONS += "meta-bolt-wpewebkit-runtime"
BBFILE_PATTERN_meta-bolt-wpewebkit-runtime = "^${LAYERDIR}/"
BBFILE_PRIORITY_meta-bolt-wpewebkit-runtime = "10"

LAYERDEPENDS_meta-bolt-wpewebkit-runtime = "bolt-base"
```
